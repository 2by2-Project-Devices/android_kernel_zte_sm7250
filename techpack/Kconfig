## techpack/Kconfig
```kconfig
menu "Tech packages"

source "techpack/data/Kconfig"

source "techpack/zte-zr01/Kconfig"

endmenu
```

## techpack/zte-zr01/Kconfig
```kconfig
menu "ZTE ZR01 project"
	depends on ARCH_LITO

config MACH_ZTE_ZR01
	bool "Support for ZTE ZR01 project"
	help
	  Say Y here to enable support for ZTE ZR01 project.

if MACH_ZTE_ZR01
endif # MACH_ZTE_ZR01

endmenu
```
